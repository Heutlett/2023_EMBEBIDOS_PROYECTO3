## yocto/emuRaspberry/conf/bblayers.conf
```bitbake
# POKY_BBLAYERS_CONF_VERSION is increased each time build/conf/bblayers.conf
# changes incompatibly
POKY_BBLAYERS_CONF_VERSION = "2"

BBPATH = "${TOPDIR}"
BBFILES ?= ""

BBLAYERS ?= " \
  /home/heutlett/yocto/poky-dunfell-23.0.2/meta \
  /home/heutlett/yocto/poky-dunfell-23.0.2/meta-poky \
  /home/heutlett/yocto/poky-dunfell-23.0.2/meta-yocto-bsp \
  /home/heutlett/yocto/poky-dunfell-23.0.2/meta-raspberrypi \
  /home/heutlett/yocto/poky-dunfell-23.0.2/meta-webcam \
  /home/heutlett/yocto/poky-dunfell-23.0.2/meta-python-flask \
  /home/heutlett/yocto/poky-dunfell-23.0.2/meta-gstreamer \
  "
```

## yocto/meta-gstreamer/conf/layer.conf
```bitbake
# We have a conf and classes directory, add to BBPATH
BBPATH .= ":${LAYERDIR}"

# We have recipes-* directories, add to BBFILES
BBFILES += "${LAYERDIR}/recipes-*/*/*.bb \
            ${LAYERDIR}/recipes-*/*/*.bbappend"

BBFILE_COLLECTIONS += "meta-gstreamer"
BBFILE_PATTERN_meta-gstreamer = "^${LAYERDIR}/"
BBFILE_PRIORITY_meta-gstreamer = "6"

LAYERDEPENDS_meta-gstreamer = "core"
LAYERSERIES_COMPAT_meta-gstreamer = "dunfell"
```
